#include <Wire.h> // Библиотека связи Arduino с устройствами по шине I2C
#include <LiquidCrystal_I2C.h> // Библиотека работы с жидкокристаллическими символьными дисплеями по шине I2C
#include <LCD_1602_RUS.h> // Библиотека вывода русского алфавита на дисплей, не поддерживающий русские символы

LCD_1602_RUS lcd(0x27,16,2); // Адрес и тип жидкокристаллического дисплея: 2 строки по 16 символов


#define LIGHT 2 // Пин считавания сигнала с фоторезистора
int lcdSymbol = 0; // Переменная для счетчика символов для дисплея
int waitTimer = 0; // Переменная для счетчика таймера ожидания лазерного сигнала
unsigned long signal, press, release; // Переменные для хранения длительности сигнала, времени приема лазерного сигнала и его исчезновения
String morze = ""; // Строка для записи морзянки

const char * dotsAndDashes[] = { ".-", "-...", ".--", "--.", "-..", ".", "...-", "--..", "..", ".---", // Массив строк азбуки Морзе
                                  "-.-", ".-..", "--", "-.", "---", ".--.", ".-.", "...", "-", "..-",
                                  "..-.", "....", "-.-.", "---.", "----", "--.-", "--.--", "-.--", "-..-", "..-..",
                                  "..--", ".-.-",
                                  ".----", "..---", "...--", "....-", ".....", "-....", "--...", "---..", "----.", "-----",
                                  "......", ".-.-.-", "---...", "-.-.-.", ".----.", ".-..-.", "-....-", "..--.-", "..--..", "--..--", ".-.-.", "-...-" };

static String symbols[] = { "А", "Б", "В", "Г", "Д", "Е", "Ж", "З", "И", "Й", // Массив алфавита, цирф и знаков, соответствующий массиву азбуки Морзе
                            "К", "Л", "М", "Н", "О", "П", "Р", "С", "Т", "У",
                            "Ф", "Х", "Ц", "Ч", "Ш", "Щ", "Ъ", "Ы", "Ь", "Э",
                            "Ю", "Я",
                            "1", "2", "3", "4", "5", "6", "7", "8", "9", "0",
                            ".", ",", ":", ";", "`", "'", "-", "_", "?", "!", "+", " " };

void setup() {
  lcd.init(); // Инициализация дисплея
  lcd.backlight(); // Включение подсветки дисплея
  lcd.clear(); // Очистка дисплея и памяти его контроллера
  pinMode(LIGHT, INPUT_PULLUP); // Инициализация пина для чтения сигнала с фоторезистора
}

void loop() {
  press = millis(); // Сохраняем время от начала цикла loop
  while (digitalRead(LIGHT)) {
    signal = millis() - press; // Вычисляем длительность лазерного сигнала: время от начала цикла loop минус время, сохраненное до цикла while. Разницу сохраняем в переменную signal
  }

  if (signal > 100) {
    morze += morzeCode(); // Если длительность сигнала больше 100 миллисекунд, запускаем функцию morzeCode()
    signal = 0; // Обнуляем переменную signal для следующего цикла
  }

  lcd.setCursor(0,0); // Устанавливаем курсор дисплея на первую строку в первую символьную ячейку
  lcd.print("Код: ");
  lcd.print(morze); // Показываем принятый код Морзе

  release = millis(); // Сохраняем время от начала цикла loop
  while (!digitalRead(LIGHT)) {
    waitTimer = millis() - release; // Вычисляем время без лазерного луча: время от исчезновения луча минус время, сохраненное до цикла while. Разницу сохраняем в переменную release

    if (waitTimer >= 2000 && morze.length() >= 1 && morze.length() <= 6) { // Если счетчик ожидания лазерного сигнала больше 2 секунд и длина строки morze больше или один символ и меньше или равен 6 символам
      if (lcdSymbol < 16) { // Если значение переменной lcdSymbol меньше 16
        lcd.setCursor(lcdSymbol,1); // то выставляем курсор на вторую строку в ячейку, соответствующую значению в переменной lcdSymbol
      } else if (lcdSymbol == 16) { // Если же значение переменной равно 16, то есть строка закончилась,
        lcd.setCursor(0,1); // то ставим курсор в начало строки
        lcdSymbol = 0; // и обнуляем переменную lcdSymbol
      }
      morze2letter(); // Запускаем функцию morze2letter()
      nullFirstRow(); // Запускаем функцию nullFirstRow()
      morze = ""; // Опустошаем строку morze
    }
  }
}

String morzeCode() { // Функция определения "точка или тире". Возвращает строковый символ
  if (signal < 300) {
    return "."; // Если длительность лазерного сигнала меньше 300 миллисекунд, то дописываем в morze точку
  } else if (signal > 300) {
    return "-"; // Если же больше 300 миллисекунд, то дописываем в morze тире
  }
}

void morze2letter() { // Функция расшифровки морзянки
  int i = 0; // Переменная для счетчика цикла
  while (i < 55) { // Цикл выполняется, пока i меньше 55 (число элементов в массиве алфавита)
    if (morze == dotsAndDashes[i]) { // Если полученный код соответствует одной из строк в массиве алфавита Морзе
      lcd.print(symbols[i]); // Выводим на дисплей букву русского алфавита
      lcd.print(" "); // Следующую ячейку заполняем пробелом
      lcdSymbol++; // Увеличиваем счетчик lcdSymbol на единицу
      break; // Прерываем цикл
    }
    i++; // Увеличиваем переменную цикла на единицу
  }
}

void nullFirstRow() { // Функция обнуления первой строки дисплея
  lcd.setCursor(0,0);
  lcd.print("Код:            ");
}
